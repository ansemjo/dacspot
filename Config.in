## Config.in
```kconfig
config DACSPOT_USE_WIRELESS
  bool "Enable WiFi support"
  select BR2_PACKAGE_BRCMFMAC_SDIO_FIRMWARE_RPI
  select BR2_PACKAGE_BRCMFMAC_SDIO_FIRMWARE_RPI_WIFI
  select BR2_PACKAGE_CRDA
  select BR2_PACKAGE_IFUPDOWN_SCRIPTS
  select BR2_PACKAGE_IW
  select BR2_PACKAGE_WIRELESS_REGDB
  select BR2_PACKAGE_WIRELESS_TOOLS
  select BR2_PACKAGE_WPA_SUPPLICANT
  select BR2_PACKAGE_WPA_SUPPLICANT_NL80211
  help
    Select the necessary brcmfmac firmware and wireless tools packages
    and write a minimal /etc/wpa_supplicant.conf file during build to
    enable automatically connecting to a WiFi network.

config DACSPOT_USE_WIRELESS_SSID
  depends on DACSPOT_USE_WIRELESS
  string "Network SSID"

config DACSPOT_USE_WIRELESS_PSK
  depends on DACSPOT_USE_WIRELESS
  string "Network PSK"

config DACSPOT_USE_WIRELESS_COUNTRY
  depends on DACSPOT_USE_WIRELESS
  string "Country"
  default "DE"


config DACSPOT_USE_NTP
  bool "Enable NTP package"
  select BR2_PACKAGE_NTP
  select BR2_PACKAGE_NTP_NTPD
  select BR2_PACKAGE_NTP_NTPDATE
  help
    Select the necessary ntp daemon packages and write a config to
    run ntpdate after boot.

config DACSPOT_USE_NTP_SERVERS
  depends on DACSPOT_USE_NTP
  string "NTP Servers"
  default "0.de.pool.ntp.org"


config DACSPOT_USE_HIFIBERRY_DAC
  bool "Enable HiFiBerry DAC support"
  select BR2_PACKAGE_ALSA_UTILS
  select BR2_PACKAGE_ALSA_UTILS_ALSACTL
  select BR2_PACKAGE_ALSA_UTILS_ALSAMIXER
  select BR2_PACKAGE_ALSA_UTILS_AMIXER
  select BR2_PACKAGE_ALSA_UTILS_APLAY
  select BR2_PACKAGE_ALSA_UTILS_SPEAKER_TEST
  select BR2_PACKAGE_ALSA_LIB


config DACSPOT_USE_USB_GSERIAL
  bool "Enable g_serial on the USB OTG port"
  default "y"
  help
    Use the DesignWare USB2 DRD Core Support (dwc2) and load the
    USB Serial Gadget module (g_serial) to use the USB OTG port for
    an easy-to-access serial console.


config DACSPOT_SSH_AUTHORIZED_KEY
  depends on BR2_PACKAGE_OPENSSH_SERVER
  string "Authorized key for root"
  default ""
  help
     Add this public key as an authorized key for the root user
     to enable passwordless login.

config DACSPOT_SSH_GENERATE_ED25519_HOSTKEY
  depends on BR2_PACKAGE_OPENSSH_SERVER
  bool "Generate ed25519 hostkey"
  default "y"
  help
    Generate an ed25519 host key, if none exists in the generated
    target filesystem. Especially useful for readonly filesystem, as
    the server won't start due to missing keys otherwise.


config DACSPOT_USE_SQUASHFS_ROOT
  depends on BR2_TARGET_ROOTFS_SQUASHFS
  bool "Use readonly SquashFS root"
  default "y"
  help
    Generate image using the readonly SquashFS rootfs.

config BR2_TARGET_GENERIC_REMOUNT_ROOTFS_RW
  bool "Remount root filesystem read-write"
  depends on !DACSPOT_USE_SQUASHFS_ROOT
  default "y"
  help
    The root filesystem is typically mounted read-only at boot.
    By default, buildroot remounts it in read-write mode early
    during the boot process.
    Say no here if you would rather like your root filesystem to
    remain read-only.
    If unsure, say Y.

config DACSPOT_MOUNT_BOOT
  bool "Mount /boot partition"
  default "n"
  help
    Mount the second partiton of the SD card (with the kernel
    image and bootloader configuration) at /boot.

config DACSPOT_MOUNT_BOOT_RO
  depends on DACSPOT_MOUNT_BOOT
  bool "Mount /boot read-only"
  default "y"


# packages
source "$BR2_EXTERNAL_DACSPOT_PATH/package/librespot/Config.in"
```

## configs/dacspot_defconfig
```kconfig
# target architecture
BR2_arm=y
BR2_arm1176jzf_s=y
BR2_ARM_EABIHF=y

# general build optimizations
BR2_CCACHE=y
BR2_OPTIMIZE_2=y
BR2_ENABLE_LTO=y

# stronger security hardening
#BR2_SSP_ALL=y
#BR2_SSP_OPTION="-fstack-protector-all"
#BR2_RELRO_FULL=y
#BR2_FORTIFY_SOURCE_2=y

# custom linux kernel with tweaks
BR2_PACKAGE_HOST_LINUX_HEADERS_CUSTOM_6_1=y
BR2_TOOLCHAIN_BUILDROOT_CXX=y
BR2_LINUX_KERNEL=y
BR2_LINUX_KERNEL_CUSTOM_TARBALL=y
BR2_LINUX_KERNEL_CUSTOM_TARBALL_LOCATION="$(call github,raspberrypi,linux,17f135b742c4edb340afb365873c3a574f7e16cb)/linux-17f135b742c4edb340afb365873c3a574f7e16cb.tar.gz"
BR2_LINUX_KERNEL_DEFCONFIG="bcmrpi"
BR2_LINUX_KERNEL_DTS_SUPPORT=y
BR2_LINUX_KERNEL_INTREE_DTS_NAME="bcm2708-rpi-zero-w"
BR2_LINUX_KERNEL_NEEDS_HOST_OPENSSL=y
BR2_LINUX_KERNEL_CONFIG_FRAGMENT_FILES="$(BR2_EXTERNAL_DACSPOT_PATH)/configs/linux_fragment"
BR2_LINUX_KERNEL_ZSTD=y

# Enable compressed kernel module support
BR2_PACKAGE_BUSYBOX_SHOW_OTHERS=y
BR2_PACKAGE_KMOD_TOOLS=y
BR2_PACKAGE_XZ=y
BR2_PACKAGE_KMOD=y
BR2_PACKAGE_HOST_KMOD_XZ=y

# raspberry pi firmware
BR2_PACKAGE_RPI_FIRMWARE=y
BR2_PACKAGE_RPI_FIRMWARE_BOOTCODE_BIN=y
BR2_PACKAGE_RPI_FIRMWARE_VARIANT_PI=y
BR2_PACKAGE_RPI_FIRMWARE_CONFIG_FILE="$(BR2_EXTERNAL_DACSPOT_PATH)/board/config.txt"

# required tools to create sdcard.img
BR2_PACKAGE_HOST_DOSFSTOOLS=y
BR2_PACKAGE_HOST_GENIMAGE=y
BR2_PACKAGE_HOST_MTOOLS=y

# generate squashfs and ext4 rootfs to pick from
BR2_TARGET_ROOTFS_SQUASHFS=y
BR2_TARGET_ROOTFS_SQUASHFS4_GZIP=y
BR2_TARGET_ROOTFS_EXT2=y
BR2_TARGET_ROOTFS_EXT2_4=y
BR2_TARGET_ROOTFS_EXT2_SIZE="128M"
# BR2_TARGET_ROOTFS_TAR is not set
# BR2_TARGET_GENERIC_REMOUNT_ROOTFS_RW is not set

# filesystem tree tweaks
BR2_ROOTFS_MERGED_USR=y
BR2_ROOTFS_OVERLAY="$(BR2_EXTERNAL_DACSPOT_PATH)/rootfs/"
BR2_ROOTFS_POST_BUILD_SCRIPT="$(BR2_EXTERNAL_DACSPOT_PATH)/board/post-build.sh"
BR2_ROOTFS_POST_IMAGE_SCRIPT="$(BR2_EXTERNAL_DACSPOT_PATH)/board/post-image.sh"

# set hostname and banner
BR2_TARGET_GENERIC_HOSTNAME="dacspot"
BR2_TARGET_GENERIC_ISSUE="Welcome to DACspot Buildroot (\\s \\r, \\v)"

# use the simplest init system
BR2_INIT_BUSYBOX=y
BR2_ROOTFS_DEVICE_CREATION_DYNAMIC_DEVTMPFS=y

# generate timezone data
BR2_TARGET_TZ_INFO=y
BR2_TARGET_LOCALTIME="Europe/Berlin"

# necessary wifi firmware
BR2_PACKAGE_BRCMFMAC_SDIO_FIRMWARE_RPI=y
BR2_PACKAGE_BRCMFMAC_SDIO_FIRMWARE_RPI_BT=y
BR2_PACKAGE_BRCMFMAC_SDIO_FIRMWARE_RPI_WIFI=y

# wireless tools
BR2_PACKAGE_CRDA=y
BR2_PACKAGE_IFUPDOWN_SCRIPTS=y
BR2_PACKAGE_IW=y
BR2_PACKAGE_WIRELESS_REGDB=y
BR2_PACKAGE_WIRELESS_TOOLS=y
BR2_PACKAGE_WPA_SUPPLICANT=y
BR2_PACKAGE_WPA_SUPPLICANT_NL80211=y

# install ntp daemon
BR2_PACKAGE_NTP=y
BR2_PACKAGE_NTP_NTPD=y
BR2_PACKAGE_NTP_NTPDATE=y

# add alsa utilities
BR2_PACKAGE_ALSA_UTILS=y
BR2_PACKAGE_ALSA_UTILS_ALSACTL=y
BR2_PACKAGE_ALSA_UTILS_ALSAMIXER=y
BR2_PACKAGE_ALSA_UTILS_AMIXER=y
BR2_PACKAGE_ALSA_UTILS_APLAY=y
BR2_PACKAGE_ALSA_UTILS_SPEAKER_TEST=y
BR2_PACKAGE_ALSA_LIB=y

# set this extension's configuration, too
DACSPOT_USE_WIRELESS=y
DACSPOT_USE_NTP=y
DACSPOT_USE_HIFIBERRY_DAC=y
DACSPOT_USE_USB_GSERIAL=y
DACSPOT_SSH_GENERATE_ED25519_HOSTKEY=y
DACSPOT_USE_SQUASHFS_ROOT=n
# DACSPOT_MOUNT_BOOT is not set
BR2_PACKAGE_LIBRESPOT=y

# a few more useful packages
BR2_PACKAGE_BUSYBOX_SHOW_OTHERS=y
BR2_PACKAGE_ZSTD=y
BR2_PACKAGE_GREP=y
BR2_PACKAGE_SED=y
BR2_PACKAGE_HAVEGED=y
BR2_PACKAGE_OPENSSH=y
BR2_PACKAGE_BASH=y
BR2_PACKAGE_BASH_COMPLETION=y
BR2_PACKAGE_TMUX=y
BR2_PACKAGE_HTOP=y

# use bash as system shell
# BR2_SYSTEM_BIN_SH_BUSYBOX is not set
BR2_SYSTEM_BIN_SH_BASH=y
BR2_SYSTEM_BIN_SH="bash"
```

## package/librespot/Config.in
```kconfig
config BR2_PACKAGE_LIBRESPOT
  bool "librespot"
  depends on BR2_PACKAGE_HOST_RUSTC_TARGET_ARCH_SUPPORTS
  select BR2_PACKAGE_HOST_RUSTC
  select BR2_PACKAGE_CA_CERTIFICATES
  help
    Open Source Spotify client library

comment "Compilation options"
  depends on BR2_PACKAGE_LIBRESPOT

config BR2_PACKAGE_LIBRESPOT_VERSION
  depends on BR2_PACKAGE_LIBRESPOT
  string "version"
  default "dev"
  help
    Use either a branch name or commit from github.com/librespot-org/librespot.

config BR2_PACKAGE_LIBRESPOT_BUILD_OPTS
  depends on BR2_PACKAGE_LIBRESPOT
  string "build options"
  default "--no-default-features --features alsa-backend"

comment "Configuration variables"
  depends on BR2_PACKAGE_LIBRESPOT

config BR2_PACKAGE_LIBRESPOT_CONF_NAME
  depends on BR2_PACKAGE_LIBRESPOT
  string "Display name"
  default "DACspot Player"
  help
    The name shown in the interface.

config BR2_PACKAGE_LIBRESPOT_CONF_DEVICE_TYPE
  depends on BR2_PACKAGE_LIBRESPOT
  string "Device type"
  default "avr"
  help
    The device type influences the icon displayed in the interface. Can be:
    computer, tablet, tv, avr, stb, audiodongle, gameconsole, castaudio, castvideo,
    automobile, smartwatch, chromebook, carthing, homething

config BR2_PACKAGE_LIBRESPOT_CONF_USERNAME
  depends on BR2_PACKAGE_LIBRESPOT
  string "Username"
  default ""
  help
    Your Spotify account login.

config BR2_PACKAGE_LIBRESPOT_CONF_PASSWORD
  depends on BR2_PACKAGE_LIBRESPOT
  string "Password"
  default ""
  help
    Your Spotify account password.

config BR2_PACKAGE_LIBRESPOT_CONF_DISABLE_DISCOVERY
  depends on BR2_PACKAGE_LIBRESPOT
  bool "Disable zeroconf discovery"
  default "n"
  help
    Disable discovery mode, so the device will only be visible to other
    players in your account.

config BR2_PACKAGE_LIBRESPOT_CONF_AUTOPLAY
  depends on BR2_PACKAGE_LIBRESPOT
  bool "Enable autoplay"
  default "y"
  help
    Automatically play similar songs when your playlist ends.

config BR2_PACKAGE_LIBRESPOT_CONF_VOLUME_CTRL
  depends on BR2_PACKAGE_LIBRESPOT
  string "Volume control"
  default "log"
  help
    The type of volume control to use from fixed, linear, log or cubic.

config BR2_PACKAGE_LIBRESPOT_CONF_BITRATE
  depends on BR2_PACKAGE_LIBRESPOT
  string "Audio Bitrate"
  default "160"
  help
    Choose the bitrate in kbps from 96, 160 or 320.
```
